## main/Kconfig.projbuild
```kconfig
menu "Example Configuration"

config BROKER_URI
    string "MQTT Broker URI"
    default "mqtts://thingsboard.maksonlee.com"
    help
        Set the URI of the MQTT broker to connect to.
        Example: mqtts://mqtt.eclipseprojects.io

config DHT11_GPIO
    int "DHT11 data GPIO"
    range 0 33
    default 23
    help
        Select an available output-capable GPIO. Do not use flash, UART,
        or boot-strapping pins without checking the board wiring.

config TIME_SERVER
    string "NTP server used before TLS startup"
    default "time.cloudflare.com"
    help
        Use a reachable internal NTP service here if public UDP/123 is blocked.
        MQTT remains stopped until initial synchronization succeeds.

config REPROVISION_GPIO
    int "Active-low Wi-Fi reset button GPIO"
    range 0 33
    default 0
    help
        The ESP32 BOOT button uses GPIO 0. After boot, hold for five seconds
        to clear only Wi-Fi configuration and restart into BLE provisioning.

config TELEMETRY_INTERVAL_SECONDS
    int "Sensor sampling and telemetry interval (seconds)"
    range 3 3600
    default 5
    help
        DHT11 reads must be more than two seconds apart. Failed samples are
        skipped; the same interval applies before trying again.

endmenu
```
